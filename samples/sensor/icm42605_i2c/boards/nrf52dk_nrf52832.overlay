/*
 * Copyright (c) 2020 TDK Invensense
 *
 * SPDX-License-Identifier: Apache-2.0
 */

&i2c0 {
	compatible = "nordic,nrf-twi";
	status = "okay";
	pinctrl-0 = <&i2c0_default>;
	pinctrl-1 = <&i2c0_sleep>;
	pinctrl-names = "default", "sleep";
	icm42605: icm42605@68 {
		compatible = "invensense,icm42605";
		status = "okay";
		reg = <0x68>;
		int-gpios = <&gpio0 11 GPIO_ACTIVE_LOW>;
	};
};
